;;; 80 characters wide please ;;;;;;;;;;;;;;;;;;;;;;;;;; 8-space tabs please ;;;


;
;;;
;;;;;  TashFloppy Multiplexer
;;;
;


;;; Connections ;;;

;See pinout.py in parent directory for pin assignments


;;; Assembler Directives ;;;

	list		P=PIC16F1704, F=INHX32, ST=OFF, MM=OFF, R=DEC, X=ON
	#include	P16F1704.inc
	errorlevel	-302	;Suppress "register not in bank 0" messages
	errorlevel	-224	;Suppress TRIS instruction not recommended msgs
	__config	_CONFIG1, _FOSC_INTOSC & _WDTE_OFF & _PWRTE_ON & _MCLRE_OFF & _CP_OFF & _BOREN_OFF & _CLKOUTEN_OFF & _IESO_OFF & _FCMEN_OFF
			;_FOSC_INTOSC	Internal oscillator, I/O on RA5
			;_WDTE_OFF	Watchdog timer disabled
			;_PWRTE_ON	Keep in reset for 64 ms on start
			;_MCLRE_OFF	RA3/!MCLR is RA3
			;_CP_OFF	Code protection off
			;_BOREN_OFF	Brownout reset off
			;_CLKOUTEN_OFF	CLKOUT disabled, I/O on RA4
			;_IESO_OFF	Internal/External switch not needed
			;_FCMEN_OFF	Fail-safe clock monitor not needed
	__config	_CONFIG2, _WRT_OFF & _PPS1WAY_OFF & _ZCDDIS_ON & _PLLEN_ON & _STVREN_ON & _LVP_OFF
			;_WRT_OFF	Write protection off
			;_PPS1WAY_OFF	PPS can change more than once
			;_ZCDDIS_ON	Zero crossing detector disabled
			;_PLLEN_ON	4x PLL on
			;_STVREN_ON	Stack over/underflow causes reset
			;_LVP_OFF	High-voltage on Vpp to program


;;; Macros ;;;

DELAY	macro	value		;Delay 3*W cycles, set W to 0
	movlw	value
	decfsz	WREG,F
	bra	$-1
	endm

DNOP	macro
	bra	$+1
	endm


;;; Pin Assignments ;;;

	#include	multiplexer_pinout.inc	;Generated by pinout.py


;;; Constants ;;;

;FLAGS:
NDIRTN	equ	7	;Set when track number decreases on step (toward rim)
HIGHDEN	equ	6	;Set if inserted disk is high-density

;GCR tachometer parameters:
TACHFCV	equ	156	;Feathering period, in units of 4.096 ms
RPMDEV	equ	1	;Feathering deviation, in units of 0.4%
Z0RPM	equ	394	;RPM in speed zone 0 (tracks 0-15)
Z1RPM	equ	429	;RPM in speed zone 1 (tracks 16-31)
Z2RPM	equ	472	;RPM in speed zone 2 (tracks 32-47)
Z3RPM	equ	525	;RPM in speed zone 3 (tracks 48-63)
Z4RPM	equ	590	;RPM in speed zone 4 (tracks 64-79)


;;; Variable Storage ;;;

	cblock	0x70	;Bank-common registers
	
	FLAGS	;You've got to have flags
	TRACK	;Current track where head is placed
	TACHFSH	;Tachometer feather swap value; swapped with CCP register value
	TACHFSL	; at intervals
	TACHFCH	;Tachometer feather count-up timer; when over limit, it swaps
	TACHFCL	; the CCP register with TACHFSH:L
	INDXCNT	;Countdown of 5 ms periods to index pulse
	X8
	X7
	X6
	X5
	X4
	X3
	X2
	X1
	X0	;Various purposes
	
	endc


;;; Vectors ;;;

	org	0x0		;Reset vector
	movlp	high Init
	goto	Init

	org	0x4		;Interrupt vector
	;fall through


;;; Interrupt Handler ;;;

Interrupt
	;TODO replace call/return with label/bra
	movlb	0		;Grab the command port as early as possible in
	movf	CMD_PORT,W	; case CA3 was pulsed
	movlb	7		;If CA3 was pulsed, handle it
	btfsc	CA3_IOCF,CA3_PIN; "
	call	IntCa3		; "
	movlb	7		;If !ENBL changed state, handle it
	btfsc	NEN_IOCF,NEN_PIN; "
	call	IntNenbl	; "
	retfie			;Done

IntNenbl
	bcf	NEN_IOCF,NEN_PIN;Clear the interrupt
	movlb	0		;If !ENBL is now low, skip ahead
	btfss	NEN_PORT,NEN_PIN; "
	bra	IntNenblFalling	; "
	;fall through		;Else fall through

IntNenblRising
	movlb	1		;Tristate RD pin
	bsf	RD_PORT,RD_PIN	; "
	return			;Done

IntNenblFalling
	movlb	1		;Drive RD pin
	bcf	RD_PORT,RD_PIN	; "
	return			;Done

IntCa3
	bcf	CA3_IOCF,CA3_PIN;Clear the interrupt
	movlb	0		;If !ENBL is high, this CA3 pulse is not for us,
	btfsc	NEN_PORT,NEN_PIN; so return
	return			; "
	callw			;Translate the command port read into a command
	movlb	30		;Switch to CLC bank, common need among commands
	brw			;CA2 CA1 CA0 SEL Effect
	bra	IntCa3DirtnLow	;0   0   0   0   Set !DIRTN low
	return			;0   0   0   1   none
	bra	IntCa3Step	;0   0   1   0   Step drive heads
	return			;0   0   1   1   Select MFM mode (ignore)
	return			;0   1   0   0   Turn motor on (ignore)
	return			;0   1   0   1   none
	return			;0   1   1   0   none
	return			;0   1   1   1   none
	bra	IntCa3DirtnHigh	;1   0   0   0   Set !DIRTN high
	bra	IntCa3Switched	;1   0   0   1   Reset SWITCHED to low
	return			;1   0   1   0   none
	return			;1   0   1   1   Select GCR mode (ignore)
	return			;1   1   0   0   Turn motor off (ignore)
	return			;1   1   0   1   none
	bra	IntCa3Eject	;1   1   1   0   Eject disk
	return			;1   1   1   1   none

IntCa3DirtnLow
	bcf	FLAGS,NDIRTN	;Set internal !DIRTN flag low
	return			;Done

IntCa3Step
	btfsc	FLAGS,NDIRTN	;If !DIRTN is high (decrement track, toward
	bra	ICStep0		; rim), skip ahead
	incf	TRACK,F		;Increment track
	movf	TRACK,W		;If we hit track 80, go back to 79
	xorlw	80		; "
	btfsc	STATUS,Z	; "
	decf	TRACK,F		; "
	return			;Done
ICStep0	movf	TRACK,W		;If track is not already 0, decrement it
	btfss	STATUS,Z	; "
	decf	TRACK,F		; "
	return			;Done

IntCa3DirtnHigh
	bsf	FLAGS,NDIRTN	;Set internal !DIRTN flag high
	return			;Done

IntCa3Switched
	bcf	CLC3GLS0,7	;Set SWITCHED low
	bcf	CLC3GLS0,6	; "
	return			;Done

IntCa3Eject
	bsf	CLC3GLS0,7	;Set SWITCHED high
	bsf	CLC3GLS0,6	; "
	return			;Done


;;; Hardware Initialization ;;;

Init
	banksel	OSCCON		;32 MHz (w/PLL) high-freq internal oscillator
	movlw	B'11110000'
	movwf	OSCCON

	banksel	RCSTA		;UART async mode, 1 MHz, receiver not enabled
	movlw	B'01001000'	; just yet, transmitter not enabled at all
	movwf	BAUDCON
	clrf	SPBRGH
	movlw	7
	movwf	SPBRGL
	movlw	B'00000100'
	movwf	TXSTA
	movlw	B'10000000'
	movwf	RCSTA

	banksel	CLC1CON		;CLC1:
	clrf	CLC1SEL0;CLCIN0	;If CLCIN0 (CA1) is low, output is LC3OUT from
	movlw	B'00010';CLCIN2	; transmitter
	movwf	CLC1SEL2; (FRX)	;If CLCIN0 (CA1) is high, output is LC3OUT from
	movlw	B'00011';CLCIN3	; receiver
	movwf	CLC1SEL3; (FTX)
	movlw	B'00100000'
	movwf	CLC1GLS0
	movlw	B'00000001'
	movwf	CLC1GLS1
	movlw	B'10000000'
	movwf	CLC1GLS2
	movlw	B'00000010'
	movwf	CLC1GLS3
	clrf	CLC1POL
	movlw	B'10000000'
	movwf	CLC1CON
	movlw	B'00001';CLCIN1	;CLC3:
	movwf	CLC3SEL0; (SEL)	;If CLCIN1 (SEL) is low, output is CLC3GLS0[7:6]
	movlw	B'01100';CCP1	; (SWITCHED)
	movwf	CLC3SEL1	;If CLCIN1 (SEL) is high, output is CCP1 (!TACH/
	movlw	B'11000000'	; INDEX)
	movwf	CLC3GLS0
	movlw	B'00000001'
	movwf	CLC3GLS1
	movlw	B'00001000'
	movwf	CLC3GLS2
	movlw	B'00000010'
	movwf	CLC3GLS3
	clrf	CLC3POL
	movlw	B'10000000'
	movwf	CLC3CON

	banksel	IOCAP		;CA3 interrupts on rising edge, !ENBL on either
	bsf	CA3_IOCP,CA3_PIN
	bsf	NEN_IOCP,NEN_PIN
	bsf	NEN_IOCN,NEN_PIN

	banksel	ANSELA		;All pins digital, not analog
	clrf	ANSELA
	clrf	ANSELC

	banksel	INLVLA		;All inputs TTL, not ST
	clrf	INLVLA
	clrf	INLVLC

	banksel	RA0PPS		;Set up PPS outputs
	movlw	B'00100';LC1OUT
	movwf	RD_PPS
	movlw	B'00110';LC3OUT
	movwf	TRX_PPS
	movlw	B'01100';CCP1
	movwf	TTX_PPS

	banksel	CKPPS		;Set up PPS inputs
	movlw	CA1_PPSI
	movwf	CLCIN0PPS
	movlw	SEL_PPSI
	movwf	CLCIN1PPS
	movlw	FTX_PPSI
	movwf	CLCIN2PPS
	movlw	FRX_PPSI
	movwf	CLCIN3PPS
	movlw	TTX_PIN
	movwf	CCP1PPS
	movlw	RX_PPSI
	movwf	RXPPS

	banksel	TRISA		;CCP1 and LC3OUT output, LC1OUT output sometimes
	bcf	TRX_PORT,TRX_PIN; but not yet, all others inputs
	bcf	TTX_PORT,TTX_PIN

	movlp	high PortToCmd	;Initialize key globals

	banksel	OSCSTAT		;Spin until PLL is ready and instruction clock
	btfss	OSCSTAT,PLLR	; gears up to 8 MHz
	bra	$-1

	banksel	RCSTA		;Enable receiver now that PLL is ready
	bsf	RCSTA,CREN

	movlw	B'10001000'	;Interrupt subsystem and interrupt-on-change
	movwf	INTCON		; interrupts on

	;fall through


;;; Mainline ;;;

WaitCommand
	movlb	0		;Spin until a byte comes in over the UART
	btfss	PIR1,RCIF	; "
	bra	$-1		; "
	movlb	3		;Grab the received byte and store it to
	movf	RCREG,W		; reference later
	movwf	X0		; "
	swapf	X0,W		;Switch off based on the high nibble of the
	andlw	B'00001111'	; command byte
	brw			; "
	bra	WaitCommand	;0x0? - invalid
	bra	WaitCommand	;0x1? - invalid
	bra	WaitCommand	;0x2? - invalid
	bra	WaitCommand	;0x3? - invalid
	bra	WaitCommand	;0x4? - invalid
	bra	WaitCommand	;0x5? - invalid
	bra	WaitCommand	;0x6? - invalid
	bra	WaitCommand	;0x7? - invalid
	bra	WaitCommand	;0x8? - invalid
	bra	WaitCommand	;0x9? - invalid
	bra	WaitCommand	;0xA? - invalid
	bra	WaitCommand	;0xB? - invalid
	bra	HwConfig	;0xC? - hardware configuration
	bra	InsertDisk	;0xD? - insert disk
	bra	DataMode	;0xE? - enter data mode
	bra	WaitCommand	;0xF? - invalid

HwConfig
	movf	X0,W		;Switch off based on the low nibble of the
	andlw	B'00001111'	; command byte
	brw			; "
	bra	HwConfigDrive	;0xC0 - no drive
	bra	HwConfigDrive	;0xC1 - 400k drive
	bra	HwConfigDrive	;0xC2 - 800k drive
	bra	HwConfigDrive	;0xC3 - superdrive
	bra	WaitCommand	;0xC4 - invalid
	bra	WaitCommand	;0xC5 - invalid
	bra	WaitCommand	;0xC6 - invalid
	bra	WaitCommand	;0xC7 - invalid
	bra	WaitCommand	;0xC8 - invalid
	bra	WaitCommand	;0xC9 - invalid
	bra	WaitCommand	;0xCA - invalid
	bra	WaitCommand	;0xCB - invalid
	bra	WaitCommand	;0xCC - invalid
	bra	WaitCommand	;0xCD - invalid
	bra	WaitCommand	;0xCE - invalid
	bra	WaitCommand	;0xCF - invalid

InsertDisk
	movf	X0,W		;Switch off based on the low nibble of the
	andlw	B'00001111'	; command byte
	brw			; "
	bra	InsertDiskHdRo	;0xD0 - insert HD disk, read-only
	bra	InsertDiskHdRw	;0xD1 - insert HD disk, read-write
	bra	InsertDiskDdRo	;0xD2 - insert DD disk, read-only
	bra	InsertDiskDdRw	;0xD3 - insert DD disk, read-write
	bra	WaitCommand	;0xD4 - invalid
	bra	WaitCommand	;0xD5 - invalid
	bra	WaitCommand	;0xD6 - invalid
	bra	WaitCommand	;0xD7 - invalid
	bra	WaitCommand	;0xD8 - invalid
	bra	WaitCommand	;0xD9 - invalid
	bra	WaitCommand	;0xDA - invalid
	bra	WaitCommand	;0xDB - invalid
	bra	WaitCommand	;0xDC - invalid
	bra	WaitCommand	;0xDD - invalid
	bra	WaitCommand	;0xDE - invalid
	bra	InsertDiskEject	;0xDF - force eject disk

DataMode
	movf	X0,W		;Switch off based on the low nibble of the
	andlw	B'00001111'	; command byte
	brw			; "
	bra	DataModeGcr	;0xE0 - auto GCR
	bra	DataModeGcr	;0xE1 - raw GCR with random noise
	bra	WaitCommand	;0xE2 - invalid
	bra	WaitCommand	;0xE3 - invalid
	bra	DataModeMfm	;0xE4 - auto MFM
	bra	WaitCommand	;0xE5 - invalid
	bra	WaitCommand	;0xE6 - invalid
	bra	WaitCommand	;0xE7 - invalid
	bra	WaitCommand	;0xE8 - invalid
	bra	WaitCommand	;0xE9 - invalid
	bra	WaitCommand	;0xEA - invalid
	bra	WaitCommand	;0xEB - invalid
	bra	WaitCommand	;0xEC - invalid
	bra	WaitCommand	;0xED - invalid
	bra	WaitCommand	;0xEE - invalid
	bra	WaitCommand	;0xEF - invalid

HwConfigDrive
	movlb	30		;Set SWITCHED high
	bsf	CLC3GLS0,7	; "
	bsf	CLC3GLS0,6	; "
	clrf	TRACK		;Select track zero
	bra	WaitCommand	;Done

InsertDiskHdRo
InsertDiskHdRw
	movlb	30		;Set SWITCHED high
	bsf	CLC3GLS0,7	; "
	bsf	CLC3GLS0,6	; "
	bsf	FLAGS,HIGHDEN	;Set high-density flag
	bra	WaitCommand	;Done

InsertDiskEject
InsertDiskDdRo
InsertDiskDdRw
	movlb	30		;Set SWITCHED high
	bsf	CLC3GLS0,7	; "
	bsf	CLC3GLS0,6	; "
	bcf	FLAGS,HIGHDEN	;Clear high-density flag
	bra	WaitCommand	;Done

DataModeGcr
	call	SetupForGcr	;Set up for GCR
DMGcr0	call	ServiceTach	;Service (feather) the tach signal
	movlb	0		;If a byte hasn't come in over the UART yet,
	btfss	PIR1,RCIF	; loop
	bra	DMGcr0		; "
	movlb	3		;If there was a framing error (or break
	btfsc	RCSTA,FERR	; character), skip ahead
	bra	DMGcr1		; "
	movf	RCREG,W		;Otherwise, read the byte to clear the
	bra	DMGcr0		; interrupt, and loop
DMGcr1	movf	RCREG,W		;Framing error, so check what byte was received
	btfsc	STATUS,Z	;If it was a zero, this was a break character,
	bra	WaitCommand	; so return to await a command byte, otherwise
	bra	DMGcr0		; loop to wait for the next data byte

DataModeMfm
	call	SetupForMfm	;Set up for MFM
DMMfm0	call	ServiceIndex	;Service the index signal
	movlb	0		;If a byte hasn't come in over the UART yet,
	btfss	PIR1,RCIF	; loop
	bra	DMMfm0		; "
	movlb	3		;If there was a framing error (or break
	btfsc	RCSTA,FERR	; character), skip ahead
	bra	DMMfm1		; "
	movf	RCREG,W		;Otherwise, read the byte to clear the
	bra	DMMfm0		; interrupt, and loop
DMMfm1	movf	RCREG,W		;Framing error, so check what byte was received
	btfsc	STATUS,Z	;If it was a zero, this was a break character,
	bra	WaitCommand	; so return to await a command byte, otherwise
	bra	DMMfm0		; loop to wait for the next data byte


;;; Subprograms ;;;

SetupForGcr
	movlb	0		;Stop and clear Timer1 so we don't have any
	clrf	T1CON		; unexpected inverts or resets
	clrf	TMR1H		; "
	clrf	TMR1L		; "
	movlw	B'00111111'	;Timer2 ticks 1:64 with instruction clock,
	movwf	T2CON		; period and postscaler set so it interrupts
	movlw	63		; once every 4.096 ms
	movwf	PR2		; "
	clrf	TMR2		;Reset Timer2
	bcf	PIR1,TMR2IF	; "
	movlb	5		;Set CCP1 to invert its output whenever Timer1
	clrf	CCPR1H		; equals 0x0001 (right after it resets)
	movlw	1		; TODO can it be zero??
	movwf	CCPR1L		; "
	clrf	CCP1CON		; "
	movlw	B'00000010'	; "
	movwf	CCP1CON		; "
	swapf	TRACK,W		;Set CCP2 to reset Timer1 at a point appropriate
	andlw	B'00000111'	; to the drive rotation speed we want to imitate
	call	StFGcr0		; based on the current track number (see LUTs
	movwf	CCPR2H		; below and associated constants above)
	swapf	TRACK,W		; "
	andlw	B'00000111'	; "
	call	StFGcr1		; "
	movwf	CCPR2L		; "
	clrf	CCP2CON		; "
	movlw	B'00001011'	; "
	movwf	CCP2CON		; "
	swapf	TRACK,W		;Set the swap value for CCP2 in a similar manner
	andlw	B'00000111'	; to the above
	call	StFGcr2		; "
	movwf	TACHFSH		; "
	swapf	TRACK,W		; "
	andlw	B'00000111'	; "
	call	StFGcr3		; "
	movwf	TACHFSL		; "
	movlb	0		;Start Timer1 again
	bsf	T1CON,TMR1ON	; "
	return			;Done
StFGcr0	brw
	retlw	high (2000000000 / (Z0RPM * (500 + RPMDEV)))
	retlw	high (2000000000 / (Z1RPM * (500 + RPMDEV)))
	retlw	high (2000000000 / (Z2RPM * (500 + RPMDEV)))
	retlw	high (2000000000 / (Z3RPM * (500 + RPMDEV)))
	retlw	high (2000000000 / (Z4RPM * (500 + RPMDEV)))
StFGcr1	brw
	retlw	low (2000000000 / (Z0RPM * (500 + RPMDEV)))
	retlw	low (2000000000 / (Z1RPM * (500 + RPMDEV)))
	retlw	low (2000000000 / (Z2RPM * (500 + RPMDEV)))
	retlw	low (2000000000 / (Z3RPM * (500 + RPMDEV)))
	retlw	low (2000000000 / (Z4RPM * (500 + RPMDEV)))
StFGcr2	brw
	retlw	high (2000000000 / (Z0RPM * (500 - RPMDEV)))
	retlw	high (2000000000 / (Z1RPM * (500 - RPMDEV)))
	retlw	high (2000000000 / (Z2RPM * (500 - RPMDEV)))
	retlw	high (2000000000 / (Z3RPM * (500 - RPMDEV)))
	retlw	high (2000000000 / (Z4RPM * (500 - RPMDEV)))
StFGcr3	brw
	retlw	low (2000000000 / (Z0RPM * (500 - RPMDEV)))
	retlw	low (2000000000 / (Z1RPM * (500 - RPMDEV)))
	retlw	low (2000000000 / (Z2RPM * (500 - RPMDEV)))
	retlw	low (2000000000 / (Z3RPM * (500 - RPMDEV)))
	retlw	low (2000000000 / (Z4RPM * (500 - RPMDEV)))
	dt	0xFF, 0xFF, 0xFF

SetupForMfm
	movlb	0		;Stop and clear Timer1 so we don't have any
	clrf	T1CON		; unexpected inverts or resets
	clrf	TMR1H		; "
	clrf	TMR1L		; "
	movlw	B'01001110'	;Timer2 ticks 1:16 with instruction clock,
	movwf	T2CON		; period and postscaler set so it interrupts
	movlw	250		; once every 40,000 cycles (5 ms)
	movwf	PR2		; "
	clrf	TMR2		;Reset Timer2
	bcf	PIR1,TMR2IF	; "
	movlb	5		;Turn off CCP2 so nothing resets Timer1, set up
	clrf	CCP2CON		; CCP1 so output is low for now but its register
	movlw	0x40		; in compare mode will trigger after 2.048 ms,
	movwf	CCPR1H		; this allows an index pulse to be set up using
	clrf	CCPR1L		; it
	clrf	CCP1CON		; "
	bsf	CCP1CON,3	; "
	movlw	5		;Set the index pulse countdown to measure 25 ms
	movwf	INDXCNT		; "
	movlb	0		;Start Timer1
	bsf	T1CON,TMR1ON	; "
	return			;Done

ServiceTach
	movlb	0		;If the feather tick period (4.096 ms) has not
	btfss	PIR1,TMR2IF	; yet elapsed, return
	return			; "
	bcf	PIR1,TMR2IF	;Clear the interrupt
	incf	TACHFCL,F	;Increment the tachometer feather count-up timer
	btfsc	STATUS,Z	; timer
	incf	TACHFCH,F	; "
	btfss	PIR1,CCP1IF	;If the tachometer signal has not recently
	return			; inverted, return
	bcf	PIR1,CCP1IF	;Clear the interrupt
	movlw	TACHFCV		;If the tachometer feather count-up timer is
	subwf	TACHFCH,W	; not yet at its limit, return
	btfss	STATUS,C	; "
	return			; "
	movwf	TACHFCH		;Set feather count-up timer for next time
	movf	TACHFSH,W	;Swap TACHFSH:L with CCPR2H:L to feather the
	movlb	5		; tachometer signal
	xorwf	CCPR2H,F	; "
	xorwf	CCPR2H,W	; "
	xorwf	CCPR2H,F	; "
	movwf	TACHFSH		; "
	movf	TACHFSL,W	; "
	xorwf	CCPR2L,F	; "
	xorwf	CCPR2L,W	; "
	xorwf	CCPR2L,F	; "
	movwf	TACHFSL		; "
	return			;Done

ServiceIndex
	movlb	0		;If the tick period (5 ms) has not yet elapsed,
	btfss	PIR1,TMR2IF	; return
	return			; "
	bcf	PIR1,TMR2IF	;Clear the interrupt
	decfsz	INDXCNT,F	;Decrement the index countdown and proceed only
	return			; when it hits zero
	movlw	40		;Set the index pulse countdown to measure 200 ms
	btfss	FLAGS,HIGHDEN	; (300 RPM) for a high density disk and 100 ms
	movlw	20		; (600 RPM) for a double density disk
	movwf	INDXCNT		; "
	;fall through

IndexPulse
	movlb	0		;Reset and start Timer1
	clrf	T1CON		; "
	clrf	TMR1H		; "
	clrf	TMR1L		; "
	bsf	T1CON,TMR1ON	; "
	movlb	5		;Set CCP1 to go high now and go low when 2.048
	movlw	B'00001001'	; ms elapse, as SetupForMfm prepared
	clrf	CCP1CON		; "
	movwf	CCP1CON		; "
	return			;Done


;;; Lookup Tables ;;;

	org	0x700

;LUT for converting raw read from command port into command
PortToCmd
	#include	multiplexer_lut.inc	;Generated by pinout.py


;;; End of Program ;;;

	end
